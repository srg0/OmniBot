FaceMode gFaceMode = FaceMode::Idle;
KeyboardLayout gKeyboardLayout = KeyboardLayout::En;
UiMode gUiMode = UiMode::Home;
Keyboard_Class::KeysState gKeyboardState;
int16_t* gRecordBuffer = nullptr;
int16_t* gTtsBuffer = nullptr;
size_t gRecordedSamples = 0;
size_t gRecordCapacitySamples = 0;
size_t gRecordCapacityBytes = 0;
size_t gTtsCapacitySamples = 0;
size_t gTtsCapacityBytes = 0;
float gEyeLookX = 0.0f;
float gEyeLookY = 0.0f;
float gEyePanelShiftX = 0.0f;
float gEyePanelShiftY = 0.0f;
uint8_t gSpeakerVolume = 255;
String gLastVoiceDiag = "boot";
String gLastHttpDiag = "boot";
String gLastKeyDiag = "-";
String gNoteInputBuffer;
String gActiveNotePath;
String gActiveNoteName;
String gNotesStatus = "Ready";
String gStorageLabel = "off";
String gLastKeySignature;
EmojiCacheEntry gEmojiCache[kEmojiCacheCap];
uint8_t gEmojiCacheSize = 0;
size_t gEmojiAssetCount = 0;
bool gTcaPressedKeys[4][14] = {};
bool gCtrlSoloHeld = false;
bool gCtrlSoloCandidate = false;
bool gG0VoiceHeld = false;
bool gRecordingToFile = false;
bool gRecordFileWriteFailed = false;
bool gPlaybackStreaming = false;
uint8_t* gDynamicPlaybackBuffer = nullptr;
volatile bool gTcaInterruptPending = false;
bool gTimeZoneConfigured = false;
bool gTimeValid = false;
bool gRealtimeActive = false;
bool gRealtimeConnected = false;
bool gRealtimeStartAfterReady = false;
bool gRealtimeRecording = false;
bool gRealtimeAwaiting = false;
bool gRealtimeGotAudio = false;
bool gRealtimeHandsFreeActive = false;
bool gRealtimeRestartAfterPlayback = false;
bool gRealtimeSmokeActive = false;
bool gRealtimeSmokeTextPending = false;
bool gRealtimeSmokeAudioPending = false;
bool gRealtimeSmokeAudioStreaming = false;
bool gRealtimeTlsVerify = true;
uint32_t gRealtimeSessionStartedMs = 0;
uint32_t gRealtimeAwaitingStartedMs = 0;
uint32_t gRealtimeSmokeAudioNextMs = 0;
uint32_t gRealtimeNextListenMs = 0;
size_t gRealtimeSmokeAudioChunkIndex = 0;
String gSerialControlBuffer;
File gActiveRecordFile;
String gActiveRecordPath;
size_t gActiveRecordBytes = 0;
size_t gActiveRecordCommittedBytes = 0;
size_t gActiveRecordExpectedBytes = 0;
std::deque<uint8_t> gRecordInflightChunks;
uint8_t gRecordNextChunkIndex = 0;
int16_t gRecordChunkBuffers[kRecordChunkBufferCount][kRecordChunkSamples];
String gRealtimeSessionId;
String gRealtimeText;
String gRealtimeReplyPath = kRealtimeReplyPcmPath;
File gRealtimeReplyFile;
size_t gRealtimeReplyBytes = 0;
uint32_t gRealtimeStartedMs = 0;
std::deque<uint8_t> gRealtimeInflightChunks;
uint8_t gRealtimeNextChunkIndex = 0;
int16_t gRealtimeInputBuffers[kRealtimeChunkBufferCount][kRealtimeInputChunkSamples];
int16_t gRealtimeUpsampleBuffer[kRealtimeOutputChunkSamples];
File gPlaybackStreamFile;
String gPlaybackStreamPath;
uint32_t gPlaybackStreamSampleRate = 0;
size_t gPlaybackStreamRemainingBytes = 0;
size_t gPlaybackStreamTotalBytes = 0;
uint8_t gPlaybackStreamNextBuffer = 0;
bool gPlaybackStreamRawPcm = false;
uint8_t gPlaybackStreamBuffers[kPlaybackBufferCount][kPlaybackChunkBytes];
// OTA apply runs on Arduino's loopTask; keep the large flash scratch buffer
// out of that task stack or the device reboots before selecting the new slot.
uint8_t gOtaIoBuffer[kOtaIoBufferBytes];
uint32_t gPlaybackStartedMs = 0;
uint32_t gPlaybackDurationMs = 0;
int16_t gVoiceTickerX = 90;
uint8_t gVoiceGraphSpeed = 0;
uint8_t gVoiceLevel8 = 28;
uint32_t gAssistantPulsePressUntilMs = 0;
uint8_t gVoiceEqBars[kPlaybackSpectrumBands] = {};
uint8_t gVoiceEqPeaks[kPlaybackSpectrumBands] = {};
BatterySnapshot gBatterySnapshot;
FocusSettings gFocusSettings;
DeviceSettings gDeviceSettings;
FocusRuntime gFocus;
PetRuntime gPet;
AssetManifestSummary gAssetManifest;
OtaManifestSummary gOtaManifest;
NotesMode gNotesMode = NotesMode::List;
bool gOtaPendingVerify = false;
bool gOtaConfirmedThisBoot = false;
bool gOtaApplyInProgress = false;
bool gOtaBootApplyMode = false;
uint32_t gOtaVerifyStartMs = 0;
uint32_t gOtaLastHealthProbeMs = 0;
String gOtaRunningSlot = "-";
String gOtaBootState = "unknown";
bool gTransferUiActive = false;
String gTransferTitle;
String gTransferDetail;
uint32_t gTransferDone = 0;
uint32_t gTransferTotal = 0;
uint32_t gTransferStartedMs = 0;
uint32_t gTransferLastRenderMs = 0;
uint16_t gTransferAccent = TFT_CYAN;
TaskHandle_t gTextTurnTaskHandle = nullptr;
portMUX_TYPE gTextTurnMux = portMUX_INITIALIZER_UNLOCKED;
TextTurnTaskResult* gCompletedTextTurn = nullptr;
TaskHandle_t gTopicTaskHandle = nullptr;
portMUX_TYPE gTopicTaskMux = portMUX_INITIALIZER_UNLOCKED;
TopicTaskResult* gCompletedTopicTask = nullptr;
std::deque<String> gPendingTextTurns;
String gActiveTextTurn;

void IRAM_ATTR onTcaKeyboardInterrupt() {
  gTcaInterruptPending = true;
}

void startHubWebSocket();
void pauseHubWebSocketForVoice();
void resumeHubWebSocketAfterVoice();
void render();
void setStatus(const String& text, uint32_t ttlMs);
void pushSystem(const String& text);
void pushError(const String& text);
bool readOtaApplyBootRequest();
void clearOtaApplyBootRequest();
void requestOtaApplyBootMode(const String& targetVersion);
bool remountSdStorage(const char* reason);
void beginTransferUi(const String& title, const String& detail, uint32_t total, uint16_t accent);
void updateTransferUi(uint32_t done, uint32_t total = 0, const String& detail = "");
void finishTransferUi(const String& statusText, bool ok);
std::vector<String> wrapText(const String& raw, int32_t pixelLimit);
String keyboardSignatureFromState();
bool ensureWifiForHttp(const char* reason, uint32_t timeoutMs = kHttpReconnectTimeoutMs);
void prepareNetworkMemory(const char* reason, bool forceTtsBuffer = false);
bool connectHubClient(WiFiClient& client, const char* reason, uint32_t readTimeoutSec = 45);
void synthesizeTcaKeyboardState();
void pollTcaKeyboardEvents();
bool hasHidKey(const Keyboard_Class::KeysState& keys, uint8_t keyCode);
void submitInput();
bool playVisibleVoiceHistoryLine();
bool downloadAndPlayResponseAudio(const String& url, const String& localPath, const String& sha256,
                                  uint32_t expectedSize, const String& title, const String& preview);
bool requestAndPlayTts(const String& text);
bool fetchLatestInboxMessage(bool forcePlay = false, bool speak = true);
bool injectInboxText(const String& text, bool speakAfter = true);
void saveHubEndpoint(const String& host, uint16_t port);
void syncClockFromNtp(bool force = false);
void flashActivityLed(uint8_t r, uint8_t g, uint8_t b, uint32_t durationMs = 180);
void updateStatusLed();
void writeWavHeader(uint8_t* h, uint32_t dataSize, uint32_t sampleRate);
void serviceRecordingToFile(bool refill = true);
void serviceRealtimeVoice();
void stopPlaybackStream();
void releaseRecordBuffer();
void releaseTtsBuffer();
void toggleRealtimeVoice();
void startRealtimeSession(bool startAfterReady);
void startRealtimeRecording();
void stopRealtimeRecordingAndCommit();
void stopRealtimeRecordingForVad();
void closeRealtimeSession(const String& reason);
void realtimeWsEvent(WStype_t type, uint8_t* payload, size_t length);
void handleHostSerialInput();
bool handleLocalCommand(const String& input);
void updateG0VoiceTrigger();
void servicePlaybackStream();
bool handleGlobalEscape();
void loadFocusSettings();
void saveFocusSettings();
void loadDeviceSettings();
void saveDeviceSettings();
void loadPetState();
void savePetState(bool force = false);
void resetPet(bool fullReset);
void servicePet();
bool handlePetKey(char key, const Keyboard_Class::KeysState& keys);
bool applyPetCare(PetCareAction action);
void setUiMode(UiMode mode);
bool focusStateRuns(FocusState state);
void focusStartOrResume();
void focusReset();
void updateFocusTimer();
void serviceFocusMetronome();
void focusTone(uint16_t freq, uint16_t durationMs);
void updateBatterySnapshot(bool force = false);
void scanAudioAssets();
bool startPlaybackStreamFromWavFile(const String& path, const String& diag);
const char* clockFaceName(uint8_t face);
void loadAssetManifestSummary();
void loadOtaManifestSummary();
void loadConversationContexts();
void scanNotes();
bool handleNotesKey(char key, const Keyboard_Class::KeysState& keys);
String currentConversationKey();
bool fetchRemoteTopicCatalog();
bool fetchSelectedTopicHistory();
bool selectRemoteCurrentTopic();
bool createRemoteTopic(const String& title, String& createdTopicKey);
bool switchTopicRelative(int delta, bool selectAndLoad);
bool startTopicTask(bool syncCatalog, bool selectCurrent, bool loadHistory, const char* statusText = nullptr,
                    bool createTopic = false, const String& createTitle = String());
void processCompletedTopicTask();
void showTopicOverlay(int8_t direction = 0, uint32_t ttlMs = 1600);
void armTopicCreate();
String defaultNewTopicTitle();
void togglePulseChatDisplay();
bool isEmojiAssetCodepoint(uint32_t codepoint);
bool decodeUtf8At(const String& value, int index, uint32_t& codepoint, int& consumed);
String normalizeEmojiDisplayText(const String& raw);
bool emojiAssetAvailable(uint32_t codepoint);
const EmojiCacheEntry* emojiCacheLookup(uint32_t codepoint);
String normalizeTopicTitleForDisplay(const String& raw, bool keepAvailableEmoji = true);
String makeTopicShortName(const String& title, int32_t threadId);
bool fetchRemoteAssetManifest();
bool fetchRemoteOtaManifest();
bool syncAssetsFromManifest();
String fitCurrentFontToWidth(String text, int32_t pixelLimit);
void drawTinyFooter(uint16_t bg, uint16_t fg, const String& text, int16_t x = 12, int16_t y = 124,
                    int16_t w = 216);
String compactBytes(uint32_t bytes);
bool applyOtaFromManifest();
void beginOtaBootGuard();
bool confirmOtaBootIfPending(const char* reason);
void rollbackPendingOta(const char* reason);
void serviceOtaBootGuard();
bool uploadRuntimeLogs();
void processCompletedTextTurn();
void maybeStartNextTextTurn();
void textTurnTask(void* arg);
bool hubUsesTls();
String hubBaseUrl();
fs::FS* activeVoiceFs();
fs::FS* fallbackVoiceFs();
bool ensurePomodoroStorageOn(fs::FS& fs);
uint64_t activeStorageTotalBytes();
uint64_t activeStorageUsedBytes();
void configureEmojiRendering();
void scanEmojiAssets();
bool executeDeviceActions(JsonVariantConst actions);
bool executeDeviceActionsJson(const String& json);
bool executeDeviceAction(JsonObjectConst action);

void mapTcaRawKeyToPhysical(uint8_t keyValue, uint8_t& row, uint8_t& col) {
  uint8_t unit = keyValue % 10;
  uint8_t tens = keyValue / 10;
  if (unit >= 1 && unit <= 8 && tens <= 6) {
    uint8_t unitZero = unit - 1;
    row = unitZero & 0x03;
    col = (tens << 1) | (unitZero >> 2);
    return;
  }
  row = 0xFF;
  col = 0xFF;
}
